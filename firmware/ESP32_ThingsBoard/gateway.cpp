/* Three-pump gateway: STM32 Master <UART> ESP32 <MQTT> ThingsBoard.
 * Node relays retain their state on RF/WiFi/MQTT loss. No OFF commands are
 * generated by timeout/reconnect. MCU power/reset behaviour is separate.
 * Board: DOIT ESP32 DEVKIT V1 (ESP32-WROOM-32); UART RX16 <- Master PA9, TX17 -> PA10, common GND.
 * Libraries: Arduino-ESP32 2.0.17, WiFiManager 2.0.17, PubSubClient 2.8, ArduinoJson 7.3.1.
 * Copy secrets.h.example to secrets.h before connecting to a real network.
 */
#include <Arduino.h>
#include <WiFiManager.h>
#include <WiFiClientSecure.h>
#include <PubSubClient.h>
#include <ArduinoJson.h>
#include <esp_system.h>
#include <time.h>
#include <stdint.h>
#include <string.h>
#include <stdio.h>
#include "config.h"
#include "wifi_button.h"

static const uint8_t NODE_COUNT = 3;
static const size_t UART_LINE_SIZE = 192;
static const uint32_t UART_RETRY_MS = 2000;
static const uint32_t UART_COMMAND_TIMEOUT_MS = 8000;
static const uint32_t REQUEST_CACHE_MS = 300000;
static const size_t CACHE_SIZE = 16;
static const char RPC_REQUEST_PREFIX[] = "v1/devices/me/rpc/request/";
static const char RPC_RESPONSE_PREFIX[] = "v1/devices/me/rpc/response/";
static const char TELEMETRY_TOPIC[] = "v1/devices/me/telemetry";
static HardwareSerial STM32Serial(2);
#if MQTT_USE_TLS
static WiFiClientSecure transport;
#else
static WiFiClient transport;
#endif
static PubSubClient mqtt(transport);

struct NodeState {
    bool seen, online, known;
    uint8_t relay, valid, humidity, soil;
    int32_t temp10;
    uint32_t sampleAge, rfAge, receivedAt;
    int16_t rssi;
    int8_t snrQuarter;
};
struct GatewayState {
    NodeState node[NODE_COUNT];
    bool masterSeen, radioReady;
    uint32_t masterReceivedAt, masterSession;
    uint32_t uartFrames, uartErrors, uartOverflows;
};
static GatewayState sharedState = {};
static SemaphoreHandle_t stateMutex;
struct Command { uint32_t id; uint8_t node, value; uint32_t masterSession; };
struct Completion {
    uint32_t id;
    uint8_t node, relay, known;
    char status[24];
};
static QueueHandle_t commandQueue, completionQueue;
static uint32_t gatewaySession;
static uint32_t nextCommandId;

/* These records are accessed ONLY by the MQTT/Arduino loop task. */
struct RequestRecord {
    bool used, set, requested, terminal, publishPending;
    uint8_t node, relay, known;
    uint32_t commandId, createdAt, finishedAt, lastPublishAt;
    char requestId[33], status[24];
};
static RequestRecord requests[CACHE_SIZE] = {};
static uint32_t lastTelemetryAt, nextMqttAttempt;
static uint32_t mqttBackoff = 1000;
static bool configReady;
static bool lastUartOnline;
static uint32_t mqttPublishErrors;


/* Only WiFiTask mutates WiFiManager/STA/AP configuration. The loop task owns
 * PubSubClient/transport, and UartTask stays independent of both network tasks.
 * This short critical section publishes portal state without a data race. */
static portMUX_TYPE wifiStateMux = portMUX_INITIALIZER_UNLOCKED;
static bool wifiPortalActive;
static bool IsWiFiPortalActive()
{
    portENTER_CRITICAL(&wifiStateMux);
    const bool active = wifiPortalActive;
    portEXIT_CRITICAL(&wifiStateMux);
    return active;
}
static void SetWiFiPortalActive(bool active)
{
    portENTER_CRITICAL(&wifiStateMux);
    wifiPortalActive = active;
    portEXIT_CRITICAL(&wifiStateMux);
}
static void OpenWiFiPortal(WiFiManager &manager, const char *apName, uint32_t &startedAt)
{
    if (manager.getConfigPortalActive()) return;
    const size_t passwordLength = strlen(WIFI_PORTAL_PASSWORD);
    if (passwordLength < 8 || passwordLength > 63) {
        Serial.println("[WiFi] Portal password must contain 8..63 characters");
        return;
    }
    /* startConfigPortal returns false in nonblocking mode even on success;
     * getConfigPortalActive is the authoritative library state. */
    SetWiFiPortalActive(true);
    startedAt = millis();
    (void)manager.startConfigPortal(apName, WIFI_PORTAL_PASSWORD);
    const bool active = manager.getConfigPortalActive();
    SetWiFiPortalActive(active);
    if (active) {
        Serial.print("[WiFi] Setup portal: ");
        Serial.println(apName);
        Serial.println("[WiFi] Open 192.168.4.1 if the captive page does not appear");
    } else Serial.println("[WiFi] Cannot start setup portal; saved credentials retained");
}
static void WiFiTask(void *)
{
    WiFiManager manager;
    manager.setDebugOutput(false); // Never print saved SSID/password in WM logs.
    manager.setConfigPortalBlocking(false);
    manager.setConfigPortalTimeout(WIFI_PORTAL_TIMEOUT_MS / 1000UL);
    manager.setAPClientCheck(false);
    manager.setWebPortalClientCheck(false);
    manager.setConnectTimeout(10);
    manager.setSaveConnectTimeout(10);
    manager.setConnectRetries(1);
    manager.setBreakAfterConfig(false); // Wrong credentials leave portal available.
    manager.setWiFiAutoReconnect(true);
    manager.setEnableConfigPortal(false); // No automatic AP merely on network loss.
    manager.setShowPassword(false);
    manager.setShowInfoErase(false);
    manager.setShowInfoUpdate(false);
    const char *menu[] = {"wifi", "exit"};
    manager.setMenu(menu, 2);
    pinMode(WIFI_PORTAL_BUTTON_PIN, INPUT_PULLUP);
    WiFi.mode(WIFI_STA); // Initialise WiFi/NVS before checking saved credentials.
    WiFi.setAutoReconnect(true);
#if MQTT_USE_TLS
    configTime(0, 0, "pool.ntp.org", "time.google.com");
#endif
    WifiPortalButton button(WIFI_PORTAL_HOLD_MS, WIFI_PORTAL_DEBOUNCE_MS);
    char apName[32];
    snprintf(apName, sizeof(apName), "Pump-Setup-%06lx",
             (unsigned long)(ESP.getEfuseMac() & 0xFFFFFFUL));
    bool saved = manager.getWiFiIsSaved();
    uint32_t lastAttemptAt = millis();
    uint32_t portalStartedAt = 0;
    bool wasConnected = false;
    if (saved) {
        WiFi.begin(); // NVS credentials managed by WiFiManager; no hardcoded SSID.
        Serial.println("[WiFi] Connecting using saved network");
    } else {
        OpenWiFiPortal(manager, apName, portalStartedAt); // First boot provisioning.
    }
    for (;;) {
        uint32_t now = millis();
        if (button.update(now, digitalRead(WIFI_PORTAL_BUTTON_PIN) == LOW))
            OpenWiFiPortal(manager, apName, portalStartedAt);
        bool active = manager.getConfigPortalActive();
        if (active) {
            /* Enforce our own fixed window even if client activity might extend
             * WiFiManager's library timeout. Library save/connect work is bounded
             * by 10 seconds; its synchronous handlers run only in this task. */
            if ((uint32_t)(now - portalStartedAt) >= WIFI_PORTAL_TIMEOUT_MS)
                manager.stopConfigPortal();
            else
                manager.process();
            active = manager.getConfigPortalActive();
            if (active && (uint32_t)(millis() - portalStartedAt) >= WIFI_PORTAL_TIMEOUT_MS) {
                manager.stopConfigPortal();
                active = manager.getConfigPortalActive();
            }
            if (!active) {
                saved = manager.getWiFiIsSaved();
                lastAttemptAt = millis();
                if (saved && WiFi.status() != WL_CONNECTED) WiFi.begin();
                Serial.println("[WiFi] Setup portal closed; saved-network mode resumed");
            }
        } else if (WiFi.status() != WL_CONNECTED && saved &&
                   (uint32_t)(now - lastAttemptAt) >= WIFI_RECONNECT_MS) {
            lastAttemptAt = now;
            WiFi.begin(); // Retry without erase/reset; pump state is unaffected.
        }
        SetWiFiPortalActive(active);
        const bool connected = WiFi.status() == WL_CONNECTED;
        if (connected && !wasConnected) Serial.println("[WiFi] Station connected");
        wasConnected = connected;
        vTaskDelay(pdMS_TO_TICKS(10));
    }
}

static uint32_t AgeAdd(uint32_t age, uint32_t elapsed)
{
    return elapsed > UINT32_MAX - age ? UINT32_MAX : age + elapsed;
}
static GatewayState Snapshot()
{
    GatewayState value;
    xSemaphoreTake(stateMutex, portMAX_DELAY);
    value = sharedState;
    xSemaphoreGive(stateMutex);
    return value;
}
static bool MasterOnline(const GatewayState &s, uint32_t now)
{
    return s.masterSeen && (uint32_t)(now - s.masterReceivedAt) < MASTER_UART_TIMEOUT_MS;
}
static bool NodeOnline(const GatewayState &s, uint8_t index, uint32_t now)
{
    const NodeState &n = s.node[index];
    return MasterOnline(s, now) && n.seen && n.online &&
           AgeAdd(n.rfAge, now - n.receivedAt) < NODE_RF_TIMEOUT_MS;
}
static bool ParseU32(const char *s, uint32_t &out)
{
    if (!s || !*s) return false;
    uint32_t n = 0;
    for (; *s; ++s) {
        if (*s < '0' || *s > '9') return false;
        uint32_t d = (uint32_t)(*s - '0');
        if (n > (UINT32_MAX - d) / 10U) return false;
        n = n * 10U + d;
    }
    out = n;
    return true;
}
static bool ParseI32(const char *s, int32_t &out)
{
    bool negative = s && *s == '-';
    if (negative) ++s;
    uint32_t n;
    if (!ParseU32(s, n) || n > (negative ? 2147483648UL : 2147483647UL)) return false;
    out = negative ? (n == 2147483648UL ? INT32_MIN : -(int32_t)n) : (int32_t)n;
    return true;
}
static size_t Split(char *line, char **fields, size_t capacity)
{
    size_t count = 0;
    if (!line || !*line) return 0;
    for (char *p = line;;) {
        if (count >= capacity || !*p) return 0;
        fields[count++] = p;
        while (*p && *p != ',') ++p;
        if (!*p) break;
        *p++ = '\0';
        if (!*p) return 0;
    }
    return count;
}
static bool ValidStatus(const char *s)
{
    static const char *const valid[] = {"OK", "BUSY", "OFFLINE", "RADIO_ERROR",
        "ACK_TIMEOUT", "CONFLICT", "BOOT_CHANGED", "BAD_REQUEST", "OVERRIDDEN"};
    for (const char *v : valid) if (strcmp(s, v) == 0) return true;
    return false;
}
static void NoteUartError(bool overflow)
{
    xSemaphoreTake(stateMutex, portMAX_DELAY);
    ++sharedState.uartErrors;
    if (overflow) ++sharedState.uartOverflows;
    xSemaphoreGive(stateMutex);
}
static void NoteMasterFrame(uint32_t now)
{
    /* Caller holds stateMutex. */
    sharedState.masterSeen = true;
    sharedState.masterReceivedAt = now;
    ++sharedState.uartFrames;
}
struct UartPending {
    bool active, terminal;
    Command command;
    Completion result;
    uint8_t attempts;
    uint32_t startedAt, sentAt;
};
static UartPending uartPending[NODE_COUNT] = {};

static void ParseMasterLine(char *line)
{
    char *f[16];
    const size_t count = Split(line, f, 16);
    if (count < 2 || strcmp(f[0], "U1") != 0) { NoteUartError(false); return; }
    const uint32_t now = millis();
    uint32_t u[12] = {};
    if (strcmp(f[1], "H") == 0 && count == 4) {
        if (!ParseU32(f[2], u[0]) || !u[0] || !ParseU32(f[3], u[1]) || u[1] > 1) {
            NoteUartError(false); return;
        }
        xSemaphoreTake(stateMutex, portMAX_DELAY);
        NoteMasterFrame(now);
        if (sharedState.masterSession && sharedState.masterSession != u[0]) {
            /* A command admitted under a previous Master boot must never be
             * retried as a fresh operation after the Master loses its RAM cache. */
            for (UartPending &pending : uartPending) {
                if (pending.active && !pending.terminal && pending.command.masterSession != u[0]) {
                    const NodeState &n = sharedState.node[pending.command.node - 1];
                    pending.result.id = pending.command.id;
                    pending.result.node = pending.command.node;
                    pending.result.relay = n.relay; pending.result.known = n.known;
                    snprintf(pending.result.status, sizeof(pending.result.status), "BOOT_CHANGED");
                    pending.terminal = true;
                }
            }
            for (NodeState &n : sharedState.node) { n.online = false; n.valid = 0; }
        }
        sharedState.masterSession = u[0];
        sharedState.radioReady = u[1] != 0;
        xSemaphoreGive(stateMutex);
        return;
    }
    if (strcmp(f[1], "N") == 0 && count == 14) {
        int32_t temp, rssi, snr;
        if (!ParseU32(f[2], u[0]) || u[0] < 1 || u[0] > NODE_COUNT ||
            !ParseU32(f[3], u[1]) || u[1] > 1 || !ParseU32(f[4], u[2]) || u[2] > 1 ||
            !ParseU32(f[5], u[3]) || u[3] > 1 || !ParseU32(f[6], u[4]) || u[4] > 3 ||
            !ParseI32(f[7], temp) || temp < -400 || temp > 1250 ||
            !ParseU32(f[8], u[5]) || u[5] > 100 || !ParseU32(f[9], u[6]) || u[6] > 100 ||
            !ParseU32(f[10], u[7]) || !ParseU32(f[11], u[8]) ||
            !ParseI32(f[12], rssi) || rssi < -200 || rssi > 50 ||
            !ParseI32(f[13], snr) || snr < -128 || snr > 127) {
            NoteUartError(false); return;
        }
        xSemaphoreTake(stateMutex, portMAX_DELAY);
        NoteMasterFrame(now);
        NodeState &n = sharedState.node[u[0] - 1];
        n.seen = true; n.online = u[1] != 0; n.known = u[2] != 0;
        n.relay = u[3]; n.valid = u[4]; n.temp10 = temp;
        n.humidity = u[5]; n.soil = u[6]; n.sampleAge = u[7]; n.rfAge = u[8];
        n.rssi = (int16_t)rssi; n.snrQuarter = (int8_t)snr; n.receivedAt = now;
        xSemaphoreGive(stateMutex);
        return;
    }
    if (strcmp(f[1], "A") == 0 && count == 8) {
        if (!ParseU32(f[2], u[0]) || u[0] != gatewaySession ||
            !ParseU32(f[3], u[1]) || !u[1] || !ParseU32(f[4], u[2]) ||
            u[2] < 1 || u[2] > NODE_COUNT || !ValidStatus(f[5]) ||
            !ParseU32(f[6], u[3]) || u[3] > 1 || !ParseU32(f[7], u[4]) || u[4] > 1) {
            NoteUartError(false); return;
        }
        xSemaphoreTake(stateMutex, portMAX_DELAY);
        NoteMasterFrame(now);
        xSemaphoreGive(stateMutex);
        UartPending &p = uartPending[u[2] - 1];
        if (!p.active || p.terminal || p.command.id != u[1]) return; // late/unrelated result
        p.result.id = u[1]; p.result.node = u[2]; p.result.relay = u[3]; p.result.known = u[4];
        const bool mismatched = strcmp(f[5], "OK") == 0 && (!u[4] || u[3] != p.command.value);
        snprintf(p.result.status, sizeof(p.result.status), "%s", mismatched ? "BAD_RESULT" : f[5]);
        p.terminal = true;
        if (u[4]) {
            xSemaphoreTake(stateMutex, portMAX_DELAY);
            sharedState.node[u[2] - 1].relay = u[3];
            sharedState.node[u[2] - 1].known = true;
            xSemaphoreGive(stateMutex);
        }
        return;
    }
    NoteUartError(false);
}

static void SendUartCommand(UartPending &p, uint32_t now)
{
    char line[80];
    const int n = snprintf(line, sizeof(line), "U1,C,%lu,%lu,%u,%u,%lu\n",
        (unsigned long)gatewaySession, (unsigned long)p.command.id,
        p.command.node, p.command.value, (unsigned long)p.command.masterSession);
    if (n > 0 && n < (int)sizeof(line)) STM32Serial.write((const uint8_t *)line, (size_t)n);
    ++p.attempts;
    p.sentAt = now;
}
static void UartTask(void *)
{
    char line[UART_LINE_SIZE];
    size_t index = 0;
    bool dropping = false;
    Completion deferred[6] = {};
    size_t deferredCount = 0;
    for (;;) {
        while (deferredCount && xQueueSend(completionQueue, &deferred[0], 0) == pdTRUE) {
            --deferredCount;
            memmove(&deferred[0], &deferred[1], deferredCount * sizeof(Completion));
        }
        size_t budget = 1024;
        while (budget-- && STM32Serial.available() > 0) {
            const int readValue = STM32Serial.read();
            if (readValue < 0) break;
            const char ch = (char)readValue;
            if (ch == '\r') continue;
            if (ch == '\n') {
                if (!dropping && index) { line[index] = '\0'; ParseMasterLine(line); }
                index = 0; dropping = false;
            } else if (!dropping) {
                if (ch == '\0' || (uint8_t)ch < 0x20 || (uint8_t)ch > 0x7e) {
                    index = 0; dropping = true; NoteUartError(false);
                } else if (index < sizeof(line) - 1) line[index++] = ch;
                else { index = 0; dropping = true; NoteUartError(true); }
            }
        }
        Command c;
        while (deferredCount < 6 && xQueueReceive(commandQueue, &c, 0) == pdTRUE) {
            if (c.node < 1 || c.node > NODE_COUNT) continue;
            UartPending &p = uartPending[c.node - 1];
            /* Network task admits only one request/node until completion; queue
             * accounting keeps this path exclusive. No request is overwritten. */
            if (p.active) {
                Completion rejected = {};
                rejected.id = c.id; rejected.node = c.node;
                snprintf(rejected.status, sizeof(rejected.status), "BUSY");
                if (xQueueSend(completionQueue, &rejected, 0) != pdTRUE) deferred[deferredCount++] = rejected;
                continue;
            }
            p = {};
            p.active = true; p.command = c; p.startedAt = millis();
            const GatewayState snapshot = Snapshot();
            if (!c.masterSession || c.masterSession != snapshot.masterSession) {
                p.result.id = c.id; p.result.node = c.node;
                p.result.relay = snapshot.node[c.node - 1].relay;
                p.result.known = snapshot.node[c.node - 1].known;
                snprintf(p.result.status, sizeof(p.result.status), "BOOT_CHANGED");
                p.terminal = true;
            } else {
                SendUartCommand(p, p.startedAt);
            }
        }
        const uint32_t now = millis();
        for (UartPending &p : uartPending) {
            if (!p.active) continue;
            if (!p.terminal && (uint32_t)(now - p.startedAt) >= UART_COMMAND_TIMEOUT_MS) {
                const GatewayState s = Snapshot();
                const NodeState &node = s.node[p.command.node - 1];
                p.result.id = p.command.id; p.result.node = p.command.node;
                p.result.relay = node.relay; p.result.known = node.known;
                snprintf(p.result.status, sizeof(p.result.status), "MASTER_TIMEOUT");
                p.terminal = true;
            }
            if (p.terminal) {
                /* Retain until the queue accepted it; a network outage cannot
                 * cause a completed command result to disappear here. */
                if (xQueueSend(completionQueue, &p.result, 0) == pdTRUE) p = {};
            } else if (p.attempts < 3 && (uint32_t)(now - p.sentAt) >= UART_RETRY_MS) {
                SendUartCommand(p, now); // identical session/id, Master deduplicates
            }
        }
        vTaskDelay(pdMS_TO_TICKS(1));
    }
}

static void SetTerminal(RequestRecord &r, const char *status, uint8_t relay, uint8_t known)
{
    r.terminal = true; r.publishPending = true;
    r.relay = relay; r.known = known;
    r.finishedAt = millis(); r.lastPublishAt = r.finishedAt - 1000U;
    snprintf(r.status, sizeof(r.status), "%s", status);
}
static bool PublishResponse(const char *requestId, const char *payload)
{
    char topic[96];
    int n = snprintf(topic, sizeof(topic), "%s%s", RPC_RESPONSE_PREFIX, requestId);
    if (n <= 0 || n >= (int)sizeof(topic) || !mqtt.connected()) return false;
    bool ok = mqtt.publish(topic, payload, false); // false=retain flag; PubSubClient sends QoS0
    if (!ok) ++mqttPublishErrors;
    return ok;
}
static void ImmediateError(const char *requestId, const char *error)
{
    char payload[96];
    snprintf(payload, sizeof(payload), "{\"error\":\"%s\"}", error);
    (void)PublishResponse(requestId, payload);
}
static RequestRecord *FindRequest(const char *id)
{
    const uint32_t now = millis();
    for (RequestRecord &r : requests) {
        if (r.used && r.terminal && !r.publishPending && (uint32_t)(now - r.finishedAt) >= REQUEST_CACHE_MS) r = {};
        if (r.used && strcmp(r.requestId, id) == 0) return &r;
    }
    return nullptr;
}
static RequestRecord *AllocateRequest(uint32_t now)
{
    RequestRecord *oldest = nullptr;
    uint32_t oldestAge = 0;
    for (RequestRecord &r : requests) {
        if (!r.used) return &r;
        if (r.terminal && !r.publishPending) {
            uint32_t age = now - r.finishedAt;
            if (!oldest || age > oldestAge) { oldest = &r; oldestAge = age; }
        }
    }
    return oldest; // bounded last-16 completed requests; never evict pending/unpublished results
}
static void MqttCallback(char *topic, byte *payload, unsigned int length)
{
    if (strncmp(topic, RPC_REQUEST_PREFIX, sizeof(RPC_REQUEST_PREFIX) - 1) != 0) return;
    const char *rawId = topic + sizeof(RPC_REQUEST_PREFIX) - 1;
    size_t idLength = strlen(rawId);
    if (!idLength || idLength > 32) return;
    for (const char *p = rawId; *p; ++p) if (*p < '0' || *p > '9') return;
    char requestId[33];
    snprintf(requestId, sizeof(requestId), "%s", rawId); // copy BEFORE any publish
    JsonDocument doc;
    if (length > 768 || deserializeJson(doc, (const byte *)payload, length)) {
        ImmediateError(requestId, "INVALID_JSON"); return;
    }
    const char *method = doc["method"] | "";
    bool set = strncmp(method, "setRelay", 8) == 0;
    bool get = strncmp(method, "getRelay", 8) == 0;
    if ((!set && !get) || strlen(method) != 9 || method[8] < '1' || method[8] > '3') {
        ImmediateError(requestId, "UNKNOWN_METHOD"); return;
    }
    uint8_t node = (uint8_t)(method[8] - '0');
    if (set && !doc["params"].is<bool>()) {
        ImmediateError(requestId, "PARAMS_MUST_BE_BOOLEAN"); return;
    }
    bool wanted = set && doc["params"].as<bool>();
    RequestRecord *existing = FindRequest(requestId);
    if (existing) {
        if (existing->node != node || existing->set != set || (set && existing->requested != wanted)) {
            ImmediateError(requestId, "REQUEST_ID_REUSED");
        } else if (existing->terminal) {
            existing->publishPending = true;
            existing->lastPublishAt = millis() - 1000U;
        }
        return; // duplicate active request never becomes a second physical command
    }
    const uint32_t now = millis();
    RequestRecord *r = AllocateRequest(now);
    if (!r) { ImmediateError(requestId, "REQUEST_CACHE_FULL"); return; }
    *r = {};
    r->used = true; r->set = set; r->requested = wanted;
    r->node = node; r->createdAt = now;
    snprintf(r->requestId, sizeof(r->requestId), "%s", requestId);
    const GatewayState s = Snapshot();
    const NodeState &n = s.node[node - 1];
    if (!s.masterSession || !NodeOnline(s, node - 1, now) || !n.known) {
        SetTerminal(*r, "OFFLINE", n.relay, n.known); return;
    }
    if (get) { SetTerminal(*r, "OK", n.relay, n.known); return; }
    /* Current record has no commandId yet; exclude it from pending check. */
    bool busy = false;
    for (const RequestRecord &other : requests)
        if (&other != r && other.used && other.set && !other.terminal && other.node == node) busy = true;
    if (busy) { SetTerminal(*r, "BUSY", n.relay, n.known); return; }
    if (nextCommandId == UINT32_MAX) { SetTerminal(*r, "ID_EXHAUSTED", n.relay, n.known); return; }
    r->commandId = ++nextCommandId;
    Command c = {r->commandId, node, (uint8_t)(wanted ? 1 : 0), s.masterSession};
    if (xQueueSend(commandQueue, &c, 0) != pdTRUE) SetTerminal(*r, "BUSY", n.relay, n.known);
}
static void DrainCompletions()
{
    Completion c;
    while (xQueueReceive(completionQueue, &c, 0) == pdTRUE) {
        for (RequestRecord &r : requests) {
            if (r.used && r.set && !r.terminal && r.commandId == c.id && r.node == c.node) {
                SetTerminal(r, c.status, c.relay, c.known);
                break;
            }
        }
    }
}
static void PublishResults(uint32_t now)
{
    if (!mqtt.connected()) return;
    for (RequestRecord &r : requests) {
        if (!r.used || !r.terminal || !r.publishPending || (uint32_t)(now - r.lastPublishAt) < 1000U) continue;
        r.lastPublishAt = now;
        char payload[112];
        if (strcmp(r.status, "OK") == 0 && r.known) {
            snprintf(payload, sizeof(payload), "%s", r.relay ? "true" : "false");
        } else {
            const bool uncertain = strcmp(r.status, "MASTER_TIMEOUT") == 0 ||
                strcmp(r.status, "ACK_TIMEOUT") == 0 || strcmp(r.status, "RADIO_ERROR") == 0 ||
                strcmp(r.status, "BAD_RESULT") == 0 || strcmp(r.status, "BOOT_CHANGED") == 0;
            snprintf(payload, sizeof(payload), "{\"error\":\"%s\",\"node\":%u,\"outcomeKnown\":%s}",
                r.status, r.node, uncertain ? "false" : "true");
        }
        if (PublishResponse(r.requestId, payload)) r.publishPending = false;
        /* Successful QoS0 publish is not end-to-end confirmation. Keep record
         * for deduplication and re-publish cached terminal results on reconnect. */
    }
}
static void PublishTelemetry(uint32_t now)
{
    const GatewayState s = Snapshot();
    const bool masterOnline = MasterOnline(s, now);
    JsonDocument doc;
    doc["master_uart_online"] = masterOnline;
    doc["master_lora_ok"] = masterOnline && s.radioReady;
    doc["master_session"] = s.masterSession;
    doc["gateway_session"] = gatewaySession;
    doc["uart_frames"] = s.uartFrames;
    doc["uart_errors"] = s.uartErrors;
    doc["uart_overflows"] = s.uartOverflows;
    doc["mqtt_publish_errors"] = mqttPublishErrors;
    char key[48];
    for (uint8_t index = 0; index < NODE_COUNT; ++index) {
        const NodeState &n = s.node[index];
        const bool online = NodeOnline(s, index, now);
        const uint32_t elapsed = n.seen ? now - n.receivedAt : 0;
        const uint32_t sampleAge = n.seen ? AgeAdd(n.sampleAge, elapsed) : UINT32_MAX;
        const bool shtValid = online && (n.valid & 1) && sampleAge < SENSOR_FRESH_MS;
        const bool soilValid = online && (n.valid & 2) && sampleAge < SENSOR_FRESH_MS;
#define NODE_KEY(suffix) snprintf(key, sizeof(key), "node%u_%s", index + 1, suffix)
        NODE_KEY("online"); doc[key] = online;
        NODE_KEY("relay_known"); doc[key] = n.known;
        bool commandPending = false;
        for (const RequestRecord &r : requests)
            if (r.used && r.set && !r.terminal && r.node == index + 1) commandPending = true;
        NODE_KEY("command_pending"); doc[key] = commandPending;
        if (n.known) { NODE_KEY("relay"); doc[key] = n.relay != 0; }
        NODE_KEY("valid"); doc[key] = shtValid && soilValid;
        NODE_KEY("sht_valid"); doc[key] = shtValid;
        NODE_KEY("soil_valid"); doc[key] = soilValid;
        NODE_KEY("sample_age_ms"); doc[key] = sampleAge;
        NODE_KEY("last_seen_age_ms"); doc[key] = n.seen ? AgeAdd(n.rfAge, elapsed) : UINT32_MAX;
        if (shtValid) {
            NODE_KEY("temperature"); doc[key] = n.temp10 / 10.0f;
            NODE_KEY("humidity"); doc[key] = n.humidity;
        }
        if (soilValid) { NODE_KEY("soil"); doc[key] = n.soil; }
        if (online) {
            NODE_KEY("rssi"); doc[key] = n.rssi;
            NODE_KEY("snr"); doc[key] = n.snrQuarter / 4.0f;
        }
#undef NODE_KEY
    }
    char payload[2048];
    const size_t needed = measureJson(doc);
    if (needed >= sizeof(payload)) { ++mqttPublishErrors; return; }
    const size_t length = serializeJson(doc, payload, sizeof(payload));
    if (!mqtt.publish(TELEMETRY_TOPIC, (const uint8_t *)payload, (unsigned int)length, false)) ++mqttPublishErrors;
    lastUartOnline = masterOnline;
}

/* Pure mapping kept separate so host tests can check every PubSubClient state. */
static const char *MqttStateReason(int state)
{
    switch (state) {
        case -4: return "CONNECTION_TIMEOUT";
        case -3: return "CONNECTION_LOST";
        case -2: return "CONNECT_FAILED";
        case -1: return "DISCONNECTED";
        case 0: return "CONNECTED";
        case 1: return "BAD_PROTOCOL";
        case 2: return "BAD_CLIENT_ID";
        case 3: return "SERVER_UNAVAILABLE";
        case 4: return "BAD_CREDENTIALS";
        case 5: return "UNAUTHORIZED";
        default: return "UNKNOWN_STATE";
    }
}
static const char *ResetReasonName(esp_reset_reason_t reason)
{
    switch (reason) {
        case ESP_RST_POWERON: return "POWERON";
        case ESP_RST_EXT: return "EXTERNAL";
        case ESP_RST_SW: return "SOFTWARE";
        case ESP_RST_PANIC: return "PANIC";
        case ESP_RST_INT_WDT: return "INTERRUPT_WATCHDOG";
        case ESP_RST_TASK_WDT: return "TASK_WATCHDOG";
        case ESP_RST_WDT: return "WATCHDOG";
        case ESP_RST_DEEPSLEEP: return "DEEP_SLEEP";
        case ESP_RST_BROWNOUT: return "BROWNOUT";
        case ESP_RST_SDIO: return "SDIO";
        default: return "UNKNOWN";
    }
}
static const char *ConfigurationIssue()
{
    if (!*THINGSBOARD_TOKEN) return "THINGSBOARD_TOKEN_EMPTY";
    if (strcmp(THINGSBOARD_TOKEN, "YOUR_DEVICE_ACCESS_TOKEN") == 0)
        return "THINGSBOARD_TOKEN_TEMPLATE_NOT_REPLACED";
#if MQTT_USE_TLS
    if (!*THINGSBOARD_ROOT_CA) return "TLS_ROOT_CA_EMPTY";
#endif
    return nullptr;
}
static bool ConfigurationReady()
{
    return ConfigurationIssue() == nullptr;
}
static void NetworkProcess(uint32_t now)
{
    if (!configReady) return;
    if (IsWiFiPortalActive()) {
        // Preserve an existing MQTT session, but do not start a new TCP/TLS
        // connection while the user is changing WiFi through the portal.
        if (mqtt.connected()) mqtt.loop();
        return;
    }
    if (WiFi.status() != WL_CONNECTED) return;
#if MQTT_USE_TLS
    /* Certificate validity needs a trustworthy wall clock. UART keeps running
     * independently while SNTP acquires time or TLS waits on the network. */
    if (time(nullptr) < 1700000000) {
        static uint32_t lastTimeNotice;
        if ((uint32_t)(now - lastTimeNotice) >= 15000U) {
            lastTimeNotice = now;
            Serial.println("[TLS] Waiting for SNTP time; check network/NTP reachability");
        }
        return;
    }
#endif
    if (mqtt.connected()) {
        mqtt.loop();
        return;
    }
    if ((int32_t)(now - nextMqttAttempt) < 0) return;
    char clientId[40];
    snprintf(clientId, sizeof(clientId), "pump-gateway-%08lx-%08lx",
             (unsigned long)(ESP.getEfuseMac() & 0xffffffffU), (unsigned long)gatewaySession);
    const uint32_t startedAt = millis();
    Serial.printf("[MQTT] Connecting host=%s port=%u tls=%s rssi=%lddBm heap=%lu minHeap=%lu\n",
        THINGSBOARD_HOST, (unsigned int)THINGSBOARD_PORT, MQTT_USE_TLS ? "on" : "off",
        (long)WiFi.RSSI(), (unsigned long)ESP.getFreeHeap(), (unsigned long)ESP.getMinFreeHeap());
    const bool ok = mqtt.connect(clientId, THINGSBOARD_TOKEN, "");
    const bool subscribed = ok && mqtt.subscribe("v1/devices/me/rpc/request/+", 1);
    const uint32_t endedAt = millis();
    if (!ok || !subscribed) {
        /* Capture state BEFORE disconnect(), which changes it to DISCONNECTED.
         * subscribe() reports sending SUBSCRIBE, not broker SUBACK acceptance. */
        const int failureState = mqtt.state();
#if MQTT_USE_TLS
        char tlsText[160] = {};
        int tlsError = 0;
        if (!ok && failureState == -2) tlsError = transport.lastError(tlsText, sizeof(tlsText));
#endif
        Serial.printf("[MQTT] %s failed state=%d reason=%s elapsedMs=%lu wifiStatus=%d rssi=%lddBm heap=%lu minHeap=%lu\n",
            ok ? "SUBSCRIBE_WRITE" : "CONNECT", failureState, MqttStateReason(failureState),
            (unsigned long)(endedAt - startedAt), (int)WiFi.status(), (long)WiFi.RSSI(),
            (unsigned long)ESP.getFreeHeap(), (unsigned long)ESP.getMinFreeHeap());
#if MQTT_USE_TLS
        /* Auth/CONNACK errors never reuse a previous TLS diagnostic. For a
         * transport failure this is the SDK's last recorded error; DNS failure
         * can leave it unchanged, so it is a diagnostic rather than proof. */
        if (tlsError) Serial.printf("[TLS] lastError=%d detail=%s\n", tlsError, tlsText);
#endif
        mqtt.disconnect();
        const uint32_t retryMs = mqttBackoff + (esp_random() % 250U);
        nextMqttAttempt = endedAt + retryMs;
        mqttBackoff = mqttBackoff < 15000U ? mqttBackoff * 2U : 30000U;
        Serial.printf("[MQTT] Retry in %lu ms; UART remains serviced\n", (unsigned long)retryMs);
        return;
    }
    Serial.printf("[MQTT] CONNECT and SUBSCRIBE_WRITE succeeded elapsedMs=%lu\n",
        (unsigned long)(endedAt - startedAt));
    mqttBackoff = 1000;
    nextMqttAttempt = endedAt;
    lastTelemetryAt = endedAt - 1000U;
    for (RequestRecord &r : requests) {
        if (r.used && r.terminal) { r.publishPending = true; r.lastPublishAt = endedAt - 1000U; }
    }
    Serial.println("[MQTT] Connected; cached states/results will be synchronized");
}
void GatewaySetup()
{
    Serial.begin(115200);
    const esp_reset_reason_t resetReason = esp_reset_reason();
    Serial.printf("[BOOT] baud=115200 reset=%s(%d) heap=%lu minHeap=%lu\n",
        ResetReasonName(resetReason), (int)resetReason,
        (unsigned long)ESP.getFreeHeap(), (unsigned long)ESP.getMinFreeHeap());
    stateMutex = xSemaphoreCreateMutex();
    commandQueue = xQueueCreate(6, sizeof(Command));
    completionQueue = xQueueCreate(16, sizeof(Completion));
    if (!stateMutex || !commandQueue || !completionQueue) {
        Serial.println("[FATAL] Cannot allocate gateway resources");
        for (;;) delay(1000);
    }
    gatewaySession = esp_random();
    if (!gatewaySession) gatewaySession = 1;
    STM32Serial.setRxBufferSize(2048);
    STM32Serial.begin(STM32_UART_BAUD, SERIAL_8N1, STM32_UART_RX_PIN, STM32_UART_TX_PIN);
#if CONFIG_FREERTOS_UNICORE
    const BaseType_t uartCore = 0;
#else
    const BaseType_t uartCore = 1;
#endif
    if (xTaskCreatePinnedToCore(UartTask, "master-uart", 6144, nullptr, 3, nullptr, uartCore) != pdPASS) {
        Serial.println("[FATAL] Cannot start UART task");
        for (;;) delay(1000);
    }
    mqtt.setServer(THINGSBOARD_HOST, THINGSBOARD_PORT);
    mqtt.setCallback(MqttCallback);
    if (!mqtt.setBufferSize(2304)) {
        Serial.println("[FATAL] Cannot allocate MQTT packet buffer");
        for (;;) delay(1000);
    }
    mqtt.setKeepAlive(30);
    mqtt.setSocketTimeout(2);
#if MQTT_USE_TLS
    transport.setCACert(THINGSBOARD_ROOT_CA);
    transport.setHandshakeTimeout(8);
#endif
    configReady = ConfigurationReady();
    Serial.printf("[CONFIG] MQTT host=%s port=%u tls=%s token=%s\n", THINGSBOARD_HOST,
        (unsigned int)THINGSBOARD_PORT, MQTT_USE_TLS ? "on" : "off",
        !*THINGSBOARD_TOKEN ? "empty" : (strcmp(THINGSBOARD_TOKEN, "YOUR_DEVICE_ACCESS_TOKEN") == 0 ? "template" : "configured"));
    if (!configReady) Serial.printf("[CONFIG] MQTT disabled reason=%s; WiFi portal/UART enabled\n", ConfigurationIssue());
    if (xTaskCreatePinnedToCore(WiFiTask, "wifi-portal", 8192, nullptr, 1, nullptr, 0) != pdPASS) {
        Serial.println("[FATAL] Cannot start WiFi provisioning task");
        for (;;) delay(1000);
    }
    Serial.println("[READY] Three-node gateway; link loss never generates a pump OFF command.");
}
void GatewayLoop()
{
    /* The Arduino loop is the ONLY owner of transport/PubSubClient/RPC cache. */
    DrainCompletions();
    NetworkProcess(millis());
    DrainCompletions();
    const uint32_t now = millis();
    PublishResults(now);
    const GatewayState snapshot = Snapshot();
    const bool masterOnline = MasterOnline(snapshot, now);
    if (mqtt.connected() && ((uint32_t)(now - lastTelemetryAt) >= 1000U || masterOnline != lastUartOnline)) {
        lastTelemetryAt = now;
        PublishTelemetry(now);
    }
    delay(2);
}
